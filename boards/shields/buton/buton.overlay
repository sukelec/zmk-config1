#include <dt-bindings/gpio/gpio.h>

/ {
    chosen {
        zmk,kscan = &kscan0;
        zmk,matrix-transform = &direct_transform;
    };

    kscan0: kscan {
        compatible = "zmk,kscan-gpio-direct";
        wakeup-source;

        input-gpios
            = <&pro_micro 0 (GPIO_ACTIVE_LOW | GPIO_PULL_UP)>
            , <&pro_micro 1 (GPIO_ACTIVE_LOW | GPIO_PULL_UP)>
            , <&pro_micro 2 (GPIO_ACTIVE_LOW | GPIO_PULL_UP)>
            , <&pro_micro 3 (GPIO_ACTIVE_LOW | GPIO_PULL_UP)>
            , <&pro_micro 4 (GPIO_ACTIVE_LOW | GPIO_PULL_UP)>
            , <&pro_micro 5 (GPIO_ACTIVE_LOW | GPIO_PULL_UP)>
            , <&pro_micro 6 (GPIO_ACTIVE_LOW | GPIO_PULL_UP)>
            , <&pro_micro 7 (GPIO_ACTIVE_LOW | GPIO_PULL_UP)>
            ;
    };

    direct_transform: direct_transform {
        compatible = "zmk,matrix-transform";
        columns = <8>;
        rows = <1>;
        map = <0 1 2 3 4 5 6 7>;
    };
};